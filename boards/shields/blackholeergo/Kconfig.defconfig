## boards/shields/blackholeergo/Kconfig.defconfig
```kconfig
if SHIELD_BLACKHOLEERGO_LEFT

config ZMK_KEYBOARD_NAME
    default "BlackHoleErgo"--bindings-dirs;/tmp/zmk-config/zmk/app/module/dts/bindings;/tmp/zmk-config/zmk/app/dts

config ZMK_SPLIT_ROLE_CENTRAL
    default y

endif # SHIELD_BLACKHOLEERGO_LEFT

if SHIELD_BLACKHOLEERGO_LEFT || SHIELD_BLACKHOLEERGO_RIGHT

config ZMK_SPLIT
    default y

endif # SHIELD_BLACKHOLEERGO_LEFT || SHIELD_BLACKHOLEERGO_RIGHT
```

## config/Kconfig.shield
```kconfig
config SHIELD_BLACKHOLEDOX_LEFT
    def_bool $(shields_list_contains,blackholedox_left)

config SHIELD_BLACKHOLEDOX_RIGHT
    def_bool $(shields_list_contains,blackholedox_right)
```
